## meta-superlite/conf/distro/superlite.conf
```bitbake
# ============================================================================
# SuperLite OS — Distro Configuration
# Minimal, musl-compatible, live-boot oriented
# ============================================================================

DISTRO = "superlite"
DISTRO_NAME = "SuperLite OS"
DISTRO_VERSION = "1.0"
DISTRO_CODENAME = "spark"

# Init system
DISTRO_FEATURES = "wayland opengl pam bluetooth wifi pci usbhost x11-vulkan-anv"
DISTRO_FEATURES:remove = "x11"

# Package manager
PACKAGE_CLASSES = "package_ipk"

# Version reporting
DISTRO_VERSION[vardepsexclude] = "DATE"
SDK_VENDOR = "-superlitesdk"
SDK_VERSION := "${@'${DISTRO_VERSION}'.replace('snapshot-${DATE}', 'snapshot')}"

# Optimization — size over speed for live USB target
DISTRO_OPTIMIZATION = "-Os"

# QA checks
WARN_QA:remove = "missing-update-alternatives"

# License
LICENSE_FLAGS_ACCEPTED += "commercial"
```

## meta-superlite/conf/layer.conf
```bitbake
# ============================================================================
# SuperLite OS — Yocto Layer Configuration
# Layer: meta-superlite
# ============================================================================

# We have a conf and classes directory, append to BBPATH
BBPATH .= ":${LAYERDIR}"

# Let BitBake know where to find recipe files
BBFILES += "${LAYERDIR}/recipes-*/*/*.bb ${LAYERDIR}/recipes-*/*/*.bbappend"

BBFILE_COLLECTIONS += "meta-superlite"
BBFILE_PATTERN_meta-superlite = "^${LAYERDIR}/"
BBFILE_PRIORITY_meta-superlite = "10"

# Layer dependencies — only require layers that actually exist
LAYERDEPENDS_meta-superlite = "core openembedded-layer"
LAYERSERIES_COMPAT_meta-superlite = "scarthgap"

# This layer provides distro, machine, and image recipes
HOSTTOOLS += "mksquashfs xorriso mcopy mkfs.vfat"
```

## meta-superlite/conf/machine/superlite-x86_64.conf
```bitbake
# ============================================================================
# SuperLite OS — Machine Configuration
# Target: x86_64 live USB / ISO with LabWC Wayland desktop
# ============================================================================

#@TYPE: Machine
#@NAME: superlite-x86_64
#@DESCRIPTION: SuperLite OS x86_64 target — Alpine-based live desktop

require conf/machine/include/x86/tune-core2.inc

# Architecture
MACHINE_FEATURES = "pcbios efi screen keyboard usbhost wifi bluetooth pci"

# Kernel — use our custom linux-superlite recipe
PREFERRED_PROVIDER_virtual/kernel = "linux-superlite"
PREFERRED_VERSION_linux-superlite = "6.12%"
KERNEL_IMAGETYPE = "bzImage"

# Bootloader — GRUB for UEFI + syslinux for Legacy BIOS
PREFERRED_PROVIDER_virtual/bootloader = "grub-efi"
GRUB_PLATFORM = "efi"

# Root filesystem — squashfs for live boot
IMAGE_FSTYPES = "squashfs-xz wic"
WKS_FILE = "superlite-live.wks"

# Serial console
SERIAL_CONSOLES = "115200;ttyS0"

# Mesa for Wayland (Gallium + LLVM)
PACKAGECONFIG:append:pn-mesa = " gallium gallium-llvm egl gbm"

# Preferred providers for desktop components
PREFERRED_PROVIDER_virtual/wayland-compositor = "labwc"

# Size constraints — aim for <500MB ISO
IMAGE_ROOTFS_EXTRA_SPACE = "0"
IMAGE_OVERHEAD_FACTOR = "1.0"
```

## meta-superlite/wic/superlite-live.wks
```
# ============================================================================
# SuperLite OS — WIC Kickstart File
# Defines the partition layout for the bootable ISO/USB image
#
# Layout:
#   - BIOS boot via syslinux/isolinux (MBR)
#   - UEFI boot via GRUB (EFI System Partition)
#   - Live rootfs as squashfs on ISO9660
# ============================================================================

# ISO9660 partition with live squashfs
part /boot --source isoimage-isorescue --sourceparams="loader=grub-efi" --ondisk sda --fstype=iso9660 --label SUPERLITE --align 1024 --use-uuid

# Include both UEFI and Legacy BIOS boot
bootloader  --ptable gpt --timeout=5 --append="boot=live console=ttyS0,115200 loglevel=7"
```
